## firmware/components/board/Kconfig
```kconfig
menu "Board"

    config BOARD_ALLOW_HTTP
        bool "Allow a plain http:// server"
        default n
        help
            For trying a board against a server on a development machine. The
            token then travels unencrypted.

endmenu
```

## firmware/main/Kconfig.projbuild
```kconfig
menu "Label printer"

    config DYMO_MEDIA_ID
        string "Label stock loaded in the printer"
        default "large-address"
        help
            The id of the media in the printer. The LabelWriter 450 can't tell
            what is loaded, so it is set here. Ids are listed in label.c.

endmenu
```
